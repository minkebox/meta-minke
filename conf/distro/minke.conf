## conf/distro/minke.conf
```bitbake
require conf/distro/poky.conf

DISTRO = "minke"
DISTRO_NAME = "Minke (MinkeBox)"
DISTRO_VERSION = "0.0.1"

MAINTAINER = "tim <tim@minkebox.com>"

POKY_DEFAULT_DISTRO_FEATURES = ""
DISTRO_FEATURES_DEFAULT = "ext2 largefile usbhost pci ptest virtualization systemd aufs"
VIRTUAL-RUNTIME_init_manager = "systemd"
DISTRO_FEATURES_BACKFILL_CONSIDERED = "sysvinit"
VIRTUAL-RUNTIME_initscripts = ""
PACKAGE_CLASSES = "package_rpm"
```

## conf/layer.conf
```bitbake
# We have a conf and classes directory, add to BBPATH
BBPATH .= ":${LAYERDIR}"

# We have recipes-* directories, add to BBFILES
BBFILES += "${LAYERDIR}/recipes-*/*.bb \
            ${LAYERDIR}/recipes-*/*.bbappend"

BBFILE_COLLECTIONS += "minke"
BBFILE_PATTERN_minke = "^${LAYERDIR}/"
BBFILE_PRIORITY_minke = "99"
LAYERVERSION_minke = "1"
LAYERSERIES_COMPAT_minke = "rocko thud zeus"
```

## wic/minkex86.wks
```
# short-description: Create an EFI disk image for genericx86*
# long-description: Creates a partitioned EFI disk image for genericx86* machines
part /boot --source bootimg-efi --sourceparams="loader=grub-efi" --ondisk sda --label msdos --active --align 1024
part swap --ondisk sda --size 64 --label swap1 --fstype=swap
part / --source rootfs --ondisk sda --fstype=ext4 --label platform --align 1024 --use-uuid

bootloader --ptable gpt --timeout=1 --append="rootfstype=ext4 console=ttyS0,115200 console=tty0"
```

## wic/minkex86pcbios.wks
```
# short-description: Create an EFI disk image for genericx86*
# long-description: Creates a partitioned EFI disk image for genericx86* machines
part --source bootimg-pcbios --ondisk sda --label boot --active --align 4 --overhead-factor 1 --extra-space 0
part / --source rootfs --ondisk sda --fstype=ext4 --label platform --align 4 --use-uuid --overhead-factor 1 --extra-space 0
bootloader  --ptable gpt --timeout=1  --append="rootwait rootfstype=ext4 console=tty0 console=ttyUSB0,115200"
```
